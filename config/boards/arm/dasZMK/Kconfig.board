## config/boards/arm/dasZMK/Kconfig.board
```kconfig
# Copyright (c) 2021 Nick Winans
# SPDX-License-Identifier: MIT

config BOARD_DASZMK
	bool "dasZMK"
	depends on SOC_NRF52840_QIAA
```

## config/boards/arm/dasZMK/Kconfig.defconfig
```kconfig
# Copyright (c) 2021 Nick Winans
# SPDX-License-Identifier: MIT

if BOARD_DASZMK

config ZMK_KEYBOARD_NAME
	default "dasZMK"

if USB

config USB_NRFX
	default y

config USB_DEVICE_STACK
	default y

endif # USB

config BT_CTLR
	default BT

config ZMK_BLE
	default y

config ZMK_USB
	default y

config ZMK_BATTERY_VOLTAGE_DIVIDER
	default y

endif # BOARD_DASZMK
```

## config/boards/arm/plapple/Kconfig.board
```kconfig
# Copyright (c) 2021 Nick Winans
# SPDX-License-Identifier: MIT

config BOARD_NICE60
	bool "plapple340"
	depends on SOC_NRF52840_QIAA
```

## config/boards/arm/plapple340/Kconfig.board
```kconfig
# Copyright (c) 2022 Martin Knobel
# SPDX-License-Identifier: MIT

config BOARD_PLAPPLE340
	bool "plapple340"
	depends on SOC_NRF52840_QIAA
```

## config/boards/arm/plapple340/Kconfig.defconfig
```kconfig
# Copyright (c) 2022 Martin Knobel
# SPDX-License-Identifier: MIT

if BOARD_PLAPPLE340

config ZMK_KEYBOARD_NAME
	default "plapple340"

if USB_DEVICE_STACK

config USB_NRFX
    default y

endif # USB_DEVICE_STACK

config BT_CTLR
	default BT

endif # BOARD_PLAPPLE340
```

## config/boards/arm/plapple405/Kconfig.board
```kconfig
# Copyright (c) Martin Knobel
# SPDX-License-Identifier: MIT

config BOARD_PLAPPLE405
	bool "plapple405"
	depends on SOC_STM32F405XG
```

## config/boards/arm/plapple405/plapple405_defconfig
```kconfig
# Copyright (c) 2022 Martin Knobel
# SPDX-License-Identifier: MIT

CONFIG_BOARD_PLAPPLE405=y

CONFIG_SOC_SERIES_STM32F4X=y
CONFIG_SOC_STM32F405XG=y

CONFIG_SYS_CLOCK_HW_CYCLES_PER_SEC=168000000

# Enable MPU
CONFIG_ARM_MPU=y

# Enable HW stack protection
CONFIG_HW_STACK_PROTECTION=y

# enable GPIO
CONFIG_GPIO=y

CONFIG_CLOCK_CONTROL=y

CONFIG_PINCTRL=y

CONFIG_PINMUX=y

CONFIG_FPU=y
```
